## exploration/zephyr_uart/explo/defconfig
```kconfig
CONFIG_PM_PARTITION_SIZE_MCUBOOT=0x10000
CONFIG_BOOT_SIGNATURE_KEY_FILE="C:/Users/trovallet/Documents/Stage/zephyr_first/keys/v1/private.key"
CONFIG_BOOT_SIGNATURE_TYPE_ECDSA_P256=y
CONFIG_MCUBOOT_LOG_LEVEL_INF=y
CONFIG_PINCTRL=y
CONFIG_GPIO=y
CONFIG_SERIAL=y
CONFIG_MAIN_STACK_SIZE=10240
CONFIG_NCS_MCUBOOT_IN_BUILD=y
CONFIG_PARTITION_MANAGER_ENABLED=y
CONFIG_FPROTECT=y
CONFIG_NRFX_GPIOTE_NUM_OF_EVT_HANDLERS=1
CONFIG_SOC_SERIES_NRF53X=y
CONFIG_ARM_TRUSTZONE_M=y
CONFIG_ARM_MPU=y
CONFIG_HW_STACK_PROTECTION=y
CONFIG_CONSOLE=y
CONFIG_UART_CONSOLE=y
CONFIG_FLASH=y
CONFIG_MINIMAL_LIBC=y
CONFIG_CBPRINTF_NANO=y
CONFIG_LOG=y
CONFIG_LOG_MODE_MINIMAL=y
CONFIG_LOG_DEFAULT_LEVEL=0
```
